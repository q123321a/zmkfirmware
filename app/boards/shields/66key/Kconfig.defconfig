## app/boards/shields/66key/Kconfig.defconfig
```kconfig
# Copyright (c) 2020 The ZMK Contributors
# SPDX-License-Identifier: MIT

if SHIELD_66key

config ZMK_KEYBOARD_NAME
	default "66key"

endif
```

## app/boards/shields/66key/Kconfig.shield
```kconfig
# Copyright (c) 2020 The ZMK Contributors
# SPDX-License-Identifier: MIT

config SHIELD_66key
	def_bool $(shields_list_contains,66key)
```

## app/boards/shields/m60/Kconfig.shield
```kconfig
# Copyright (c) 2020 The ZMK Contributors
# SPDX-License-Identifier: MIT

config SHIELD_m60
	def_bool $(shields_list_contains,66key)
```
